## Kconfig
```kconfig
mainmenu "C/CPP CMake project framework Kconfig configuration"

menu "Toolchain configuration"
	config TOOLCHAIN_PATH
		string "toolchain path"
		default ""

	config TOOLCHAIN_PREFIX
		string "toolchain prefix"
		default ""
endmenu

menu "SDK Components Configuration"
	osource "${SDK_PATH}/components/*/Kconfig"
	osource "${CUSTOM_COMPONENTS_PATH}/*/Kconfig"
endmenu
menu "Project Components Configuration"
	osource "${PROJECT_PATH}/../components/*/Kconfig"
	osource "${PROJECT_PATH}/*/Kconfig"
	osource "${PROJECT_PATH}/components/*/Kconfig"
endmenu
```

## components/component1/Kconfig
```kconfig
menu "Component1 configuration"
    config COMPONENT1_INCLUDE_STATIC_LIB
        bool "Enable include static lib(from gcc)"
        default n
        help
            Enable include static lib(from gcc)
endmenu
```

## components/component2/Kconfig
```kconfig
menu "Component2 configuration"
    config COMPONENT2_ENABLED
        bool "Enable component2"
        help
            Select this option to enable component2 and show the submenu.
    menu "Component2 configuration menu2"
        visible if COMPONENT2_ENABLED
        choice COMPONENT2_TEST_STR
            prompt "Component2 test string"
            depends on COMPONENT2_ENABLED
            help
                Component2 test string in lib2_test func.

            config COMPONENT2_TEST_STR1
                bool "component2 test string 1"

            config COMPONENT2_TEST_STR2
                bool "component2 test string 2"

            config COMPONENT2_TEST_STR3
                bool "component2 test string 3"
        endchoice
    endmenu
endmenu
```

## components/component3/Kconfig
```kconfig
menuconfig COMPONENT3_ENABLED
    bool "Enable component3"
    default y

    config COMPONENT3_DYNAMIC
        bool "compile component as dynamic(shared) lib"
        default y
        depends on COMPONENT3_ENABLED
```
